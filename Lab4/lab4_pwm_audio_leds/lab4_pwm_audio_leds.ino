// =============================================================================
// CSCE 491 Lab 4 - PWM Audio + Addressable LEDs (ESP32-S3)
// Low-level drivers for LEDC (PWM audio on pin 14) and RMT (WS2812 on pin 33).
//
// Requirements satisfied:
//   (1) All register addresses are #defined.
//   (2) void setup_RMT()
//   (3) void setup_LEDC()
//   (4) void update_PWM(uint32_t initial, uint32_t sample)
//   (5) void transmit_led_signal(uint32_t *colors)   // 100 LEDs
//
// Hardware: 12 VDC -> VBATT (LIMIT 100 mA!), USB-C for logic + LED power.
// =============================================================================

#include <Arduino.h>
#include <math.h>
#include "soc/soc.h"
#include "array.h"   // generated by audioToPCM.py: sampleRate + sampleArray[]

// -----------------------------------------------------------------------------
// SYSTEM (clock gate / reset) registers
// -----------------------------------------------------------------------------
#define SYSTEM_PERIP_CLK_EN0_REG   0x600C0018
#define SYSTEM_PERIP_RST_EN0_REG   0x600C0020
#define SYSTEM_RMT_CLK_EN_BIT      (1u << 9)
#define SYSTEM_RMT_RST_BIT         (1u << 9)
#define SYSTEM_LEDC_CLK_EN_BIT     (1u << 11)
#define SYSTEM_LEDC_RST_BIT        (1u << 11)

// -----------------------------------------------------------------------------
// RMT registers
// -----------------------------------------------------------------------------
#define RMT_CH0_CONF0_REG          0x60016020
#define RMT_INT_RAW_REG            0x60016070
#define RMT_INT_CLR_REG            0x6001607C
#define RMT_SYS_CONF_REG           0x600160C0
#define RMT_RAM_BASE               0x60016800   // CH0 block

// RMT_CH0_CONF0 bit/field positions
#define RMT_TX_START_CH0           (1u << 0)
#define RMT_MEM_RD_RST_CH0         (1u << 1)
#define RMT_IDLE_OUT_LV_CH0        (1u << 6)   // (we set to 0)
#define RMT_IDLE_OUT_EN_CH0        (1u << 7)
#define RMT_CARRIER_EN_CH0         (1u << 22)
#define RMT_CONF_UPDATE_CH0        (1u << 24)
// fields:
//   RMT_DIV_CNT_CH0   bits [15:8]
//   RMT_MEM_SIZE_CH0  bits [19:16]

#define RMT_CH0_TX_END_INT         (1u << 0)

// -----------------------------------------------------------------------------
// LEDC registers
// -----------------------------------------------------------------------------
#define LEDC_CH0_CONF0_REG         0x60019000
#define LEDC_CH0_CONF1_REG         0x6001900C
#define LEDC_CH0_DUTY_REG          0x60019008
#define LEDC_TIMER0_CONF_REG       0x600190A0
#define LEDC_INT_RAW_REG           0x600190C0
#define LEDC_INT_CLR_REG           0x600190CC
#define LEDC_CONF_REG              0x600190D0

#define LEDC_TIMER0_OVF_INT        (1u << 0)
#define LEDC_DUTY_START_CH0        (1u << 31)
#define LEDC_PARA_UP_CH0           (1u << 4)
#define LEDC_SIG_OUT_EN_CH0        (1u << 2)
#define LEDC_TIMER0_PARA_UP        (1u << 25)

// -----------------------------------------------------------------------------
// GPIO matrix / IOMUX
// -----------------------------------------------------------------------------
#define GPIO_FUNC14_OUT_SEL_CFG_REG  (0x60004000 + 0x0554 + 14 * 4)
#define GPIO_FUNC33_OUT_SEL_CFG_REG  (0x60004000 + 0x0554 + 33 * 4)
#define IO_MUX_GPIO14_REG            (0x60009000 + (14 + 1) * 4)
#define IO_MUX_GPIO33_REG            (0x60009000 + (33 + 1) * 4)

#define LEDC_LS_SIG_OUT0_IDX  73   // LEDC ch0 -> GPIO output signal index
#define RMT_SIG_OUT0_IDX      81   // RMT  ch0 -> GPIO output signal index
#define MCU_SEL_FUNC          2    // selects "GPIO function" path through IOMUX

// -----------------------------------------------------------------------------
// WS2812 timing in 12.5 ns ticks (80 MHz / divider 1)
// -----------------------------------------------------------------------------
#define T0H_TICKS  32   // 400 ns
#define T0L_TICKS  68   // 850 ns
#define T1H_TICKS  64   // 800 ns
#define T1L_TICKS  36   // 450 ns

#define NUM_LEDS   100

// -----------------------------------------------------------------------------
// Helpers - the lab says use REG_WRITE/REG_READ/REG_SET_BIT/REG_CLR_BIT.
// They are provided by soc.h on the ESP32 Arduino core.
// -----------------------------------------------------------------------------

// =============================================================================
// setup_RMT()
// =============================================================================
void setup_RMT() {
  // (1) Turn on the RMT clock gate
  REG_SET_BIT(SYSTEM_PERIP_CLK_EN0_REG, SYSTEM_RMT_CLK_EN_BIT);

  // (2) Pulse RMT through reset
  REG_SET_BIT(SYSTEM_PERIP_RST_EN0_REG, SYSTEM_RMT_RST_BIT);
  REG_CLR_BIT(SYSTEM_PERIP_RST_EN0_REG, SYSTEM_RMT_RST_BIT);

  // (3) RMT_SYS_CONF_REG:
  //     RMT_CLK_EN(31)=1, RMT_SCLK_DIV_NUM=0 (divider=1),
  //     RMT_MEM_CLK_FORCE_ON(1)=1, RMT_APB_FIFO_MASK(0)=0,
  //     RMT_SCLK_SEL(25:24)=1 (APB 80 MHz), RMT_SCLK_ACTIVE(26)=1
  uint32_t sysconf = 0;
  sysconf |= (1u << 31);          // RMT_CLK_EN
  sysconf |= (1u << 26);          // RMT_SCLK_ACTIVE
  sysconf |= (1u << 24);          // RMT_SCLK_SEL = 1 (APB)
  sysconf |= (0u << 4);           // RMT_SCLK_DIV_NUM = 0  (divides by NUM+1 = 1)
  sysconf |= (1u << 1);           // RMT_MEM_CLK_FORCE_ON
  // bit 0 RMT_APB_FIFO_MASK left at 0
  REG_WRITE(RMT_SYS_CONF_REG, sysconf);

  // (4) RMT_CH0_CONF0_REG:
  //     RMT_DIV_CNT_CH0=1, RMT_MEM_SIZE_CH0=1, carrier off,
  //     idle out enable=1, idle level=0, conf_update=1
  uint32_t ch0 = 0;
  ch0 |= (1u <<  8);              // RMT_DIV_CNT_CH0 = 1  (bits 15:8)
  ch0 |= (1u << 16);              // RMT_MEM_SIZE_CH0 = 1 (bits 19:16)
  ch0 |= RMT_IDLE_OUT_EN_CH0;     // bit 7
  // RMT_IDLE_OUT_LV_CH0 (bit 6) = 0
  // RMT_CARRIER_EN_CH0  (bit 22) = 0
  ch0 |= RMT_CONF_UPDATE_CH0;     // bit 24
  REG_WRITE(RMT_CH0_CONF0_REG, ch0);

  // Clear any stale TX_END interrupt
  REG_WRITE(RMT_INT_CLR_REG, RMT_CH0_TX_END_INT);

  // (5) Route RMT ch0 output to pin 33 via GPIO matrix + IOMUX
  REG_WRITE(GPIO_FUNC33_OUT_SEL_CFG_REG, RMT_SIG_OUT0_IDX);  // OEN_INV=0, OEN_SEL=0
  // IOMUX: MCU_SEL = 2 (GPIO function), enable output. MCU_SEL is bits [14:12].
  uint32_t iomux33 = REG_READ(IO_MUX_GPIO33_REG);
  iomux33 &= ~(0x7u << 12);
  iomux33 |=  (MCU_SEL_FUNC << 12);
  REG_WRITE(IO_MUX_GPIO33_REG, iomux33);
}

// =============================================================================
// setup_LEDC()
// =============================================================================
void setup_LEDC() {
  // (1) clock gate on, (2) take out of reset
  REG_SET_BIT(SYSTEM_PERIP_CLK_EN0_REG, SYSTEM_LEDC_CLK_EN_BIT);
  REG_SET_BIT(SYSTEM_PERIP_RST_EN0_REG, SYSTEM_LEDC_RST_BIT);
  REG_CLR_BIT(SYSTEM_PERIP_RST_EN0_REG, SYSTEM_LEDC_RST_BIT);

  // (3) LEDC_CONF_REG: bit31 enable register clock, bit0 select APB clk source
  REG_WRITE(LEDC_CONF_REG, (1u << 31) | (1u << 0));

  // (4) Compute (10.8) divider so that PWM period = 1/sampleRate
  //     whole = floor(80e6 / R), frac = (80e6/R - whole) * 256
  double ratio = 80000000.0 / (double)sampleRate;
  uint32_t whole = (uint32_t)floor(ratio);
  uint32_t frac  = (uint32_t)((ratio - (double)whole) * 256.0);
  uint32_t divider = (whole << 8) | (frac & 0xFF);   // 18-bit value

  // LEDC_TIMER0_CONF_REG layout:
  //   [3:0]   LEDC_TIMER0_DUTY_RES        = 8
  //   [21:4]  LEDC_CLK_DIV_TIMER0         = divider (18 bits)
  //   [22]    LEDC_TIMER0_PAUSE           = 0
  //   [23]    LEDC_TIMER0_RST             = 0
  //   [25]    LEDC_TIMER0_PARA_UP         = 1
  uint32_t tconf = 0;
  tconf |= (8u & 0xF);                     // duty resolution = 8 bits
  tconf |= ((divider & 0x3FFFF) << 4);     // 18-bit divider
  // bit 23 RST = 0
  tconf |= LEDC_TIMER0_PARA_UP;            // bit 25
  REG_WRITE(LEDC_TIMER0_CONF_REG, tconf);

  // (5) LEDC_CH0_CONF0_REG:
  //   [1:0] LEDC_TIMER_SEL_CH0 = 0 (timer 0)
  //   [2]   LEDC_SIG_OUT_EN_CH0 = 1
  //   [4]   LEDC_PARA_UP_CH0    = 1
  uint32_t ch0 = 0;
  ch0 |= (0u << 0);
  ch0 |= LEDC_SIG_OUT_EN_CH0;
  ch0 |= LEDC_PARA_UP_CH0;
  REG_WRITE(LEDC_CH0_CONF0_REG, ch0);

  // Clear any pending overflow interrupt
  REG_WRITE(LEDC_INT_CLR_REG, LEDC_TIMER0_OVF_INT);

  // (6) Route LEDC ch0 -> pin 14 via GPIO matrix + IOMUX
  REG_WRITE(GPIO_FUNC14_OUT_SEL_CFG_REG, LEDC_LS_SIG_OUT0_IDX);
  uint32_t iomux14 = REG_READ(IO_MUX_GPIO14_REG);
  iomux14 &= ~(0x7u << 12);
  iomux14 |=  (MCU_SEL_FUNC << 12);
  REG_WRITE(IO_MUX_GPIO14_REG, iomux14);
}

// =============================================================================
// update_PWM(initial, sample)
//   - if initial==0 and the timer hasn't overflowed yet, return immediately
//   - otherwise clear the overflow flag and write the new duty cycle
// =============================================================================
void update_PWM(uint32_t initial, uint32_t sample) {
  if (!initial) {
    if (!(REG_READ(LEDC_INT_RAW_REG) & LEDC_TIMER0_OVF_INT)) {
      return;   // not yet time for next sample
    }
    REG_WRITE(LEDC_INT_CLR_REG, LEDC_TIMER0_OVF_INT);
  }

  // Duty register: whole bits live in [18:4]; lower 4 bits are the fraction.
  REG_WRITE(LEDC_CH0_DUTY_REG, (sample & 0xFF) << 4);

  // Commit: PARA_UP on conf0, then DUTY_START on conf1
  REG_SET_BIT(LEDC_CH0_CONF0_REG, LEDC_PARA_UP_CH0);
  REG_SET_BIT(LEDC_CH0_CONF1_REG, LEDC_DUTY_START_CH0);
}

// =============================================================================
// Helpers for the RMT: pack one (level,period) half-entry
// =============================================================================
static inline uint32_t rmt_pair(uint32_t hi_level, uint32_t hi_period,
                                uint32_t lo_level, uint32_t lo_period) {
  return ((hi_level & 1u) << 15) | (hi_period & 0x7FFF) |
         (((lo_level & 1u) << 31) | ((lo_period & 0x7FFF) << 16));
}

// Send one 24-bit GRB color through RMT channel 0
static void rmt_send_color(uint32_t grb) {
  volatile uint32_t *ram = (volatile uint32_t *)RMT_RAM_BASE;

  for (int i = 0; i < 24; i++) {
    int bit = (grb >> (23 - i)) & 1;
    if (bit) {
      ram[i] = rmt_pair(1, T1H_TICKS, 0, T1L_TICKS);
    } else {
      ram[i] = rmt_pair(1, T0H_TICKS, 0, T0L_TICKS);
    }
  }
  ram[24] = 0;   // zero termination

  // Reset the read pointer, then kick off TX
  REG_SET_BIT(RMT_CH0_CONF0_REG, RMT_MEM_RD_RST_CH0);
  REG_CLR_BIT(RMT_CH0_CONF0_REG, RMT_MEM_RD_RST_CH0);
  REG_SET_BIT(RMT_CH0_CONF0_REG, RMT_CONF_UPDATE_CH0);
  REG_SET_BIT(RMT_CH0_CONF0_REG, RMT_TX_START_CH0);

  // Wait for completion
  while (!(REG_READ(RMT_INT_RAW_REG) & RMT_CH0_TX_END_INT)) { /* spin ~30us */ }
  REG_WRITE(RMT_INT_CLR_REG, RMT_CH0_TX_END_INT);
}

// =============================================================================
// transmit_led_signal(colors)
//   colors[i] is a 24-bit 0x00RRGGBB value for LED i.
//   WS2812 expects bits in GRB order, MSB first.
// =============================================================================
void transmit_led_signal(uint32_t *colors) {
  for (int i = 0; i < NUM_LEDS; i++) {
    uint32_t c = colors[i];
    uint8_t r = (c >> 16) & 0xFF;
    uint8_t g = (c >>  8) & 0xFF;
    uint8_t b =  c        & 0xFF;
    uint32_t grb = ((uint32_t)g << 16) | ((uint32_t)r << 8) | b;
    rmt_send_color(grb);
  }
  delayMicroseconds(60);   // >50us idle => latch / reset
}

// =============================================================================
// Visualization helpers
// =============================================================================
static uint32_t color_for_value(uint8_t value) {
  uint8_t r, g, b;
  if (value <= 51) {            // Blue -> Cyan
    r = 0;       g = value * 5; b = 255;
  } else if (value <= 102) {    // Cyan -> Green
    r = 0;       g = 255;       b = 255 - (value - 51) * 5;
  } else if (value <= 153) {    // Green -> Yellow
    r = (value - 102) * 5; g = 255; b = 0;
  } else if (value <= 204) {    // Yellow -> Orange/Red
    r = 255; g = 255 - (value - 153) * 5; b = 0;
  } else {                      // Red (-> white at the very top)
    r = 255; g = 0; b = (value < 230) ? 0 : (value - 204) * 4;
  }
  // dim it a bit so we don't blast 100 LEDs at full brightness on USB
  r >>= 2; g >>= 2; b >>= 2;
  return ((uint32_t)r << 16) | ((uint32_t)g << 8) | b;
}

static void build_visualization(uint8_t duty, uint32_t *colors) {
  // num_lit = round( log10(duty+1)/log10(256) * 100 )
  double log_val = log10((double)duty + 1.0) / log10(256.0);
  int num_lit = (int)lround(log_val * 100.0);
  if (num_lit < 0)        num_lit = 0;
  if (num_lit > NUM_LEDS) num_lit = NUM_LEDS;

  uint32_t color = color_for_value(duty);
  for (int i = 0; i < NUM_LEDS; i++) {
    colors[i] = (i < num_lit) ? color : 0;
  }
}

// =============================================================================
// Arduino entry points
// =============================================================================
static uint32_t led_colors[NUM_LEDS];

void setup() {
  Serial.begin(115200);
  delay(200);
  Serial.println("Lab 4: PWM audio + WS2812 visualizer starting...");
  Serial.print("Sample rate: "); Serial.println(sampleRate);
  Serial.print("Sample count: "); Serial.println(sizeof(sampleArray));

  setup_LEDC();
  setup_RMT();

  // Blank the LEDs
  for (int i = 0; i < NUM_LEDS; i++) led_colors[i] = 0;
  transmit_led_signal(led_colors);

  // Prime the PWM with the first sample
  update_PWM(1, sampleArray[0]);
}

void loop() {
  static uint32_t idx       = 0;
  static uint32_t frame_ctr = 0;
  const  uint32_t total     = sizeof(sampleArray);

  // Update LED visualization every ~1024 samples (~ tens of ms at typical R)
  // -- this keeps the audio loop hot.
  if ((frame_ctr & 0x3FF) == 0) {
    build_visualization(sampleArray[idx], led_colors);
    transmit_led_signal(led_colors);
  }
  frame_ctr++;

  // Busy-wait the PWM until it's time for the next sample
  update_PWM(0, sampleArray[idx]);

  // Only advance the sample index when the PWM actually consumed one.
  // We detect this by re-checking the OVF bit -- but update_PWM clears it,
  // so instead we just spin here until the duty register has been written:
  // simpler approach -- block in update_PWM by looping until the flag is set.
  static bool waiting = true;
  if (waiting) {
    // First call returned without doing work; spin until the flag fires.
    while (!(REG_READ(LEDC_INT_RAW_REG) & LEDC_TIMER0_OVF_INT)) { }
    update_PWM(1, sampleArray[idx]);   // force-write
  }

  idx++;
  if (idx >= total) idx = 0;   // loop the song
}
